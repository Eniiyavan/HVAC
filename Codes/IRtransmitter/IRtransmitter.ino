#include <Arduino.h>
#include <IRremoteESP8266.h>
#include <IRsend.h>
#include <DHT.h>

#define DHTPIN D4     // Pin connected to the data pin of DHT11
#define DHTTYPE DHT11 
#define BUZZER_PIN D3 

const uint16_t kIrLed = 4;  // ESP8266 GPIO pin to use. Recommended: 4 (D2).
DHT dht(DHTPIN,DHTTYPE);
IRsend irsend(kIrLed);  // Set the GPIO to be used to sending the message.

// Example of data captured by IRrecvDumpV2.ino
uint16_t rawData25[200] = {3228, 3130,  476, 340,  498, 332,  472, 392,  468, 1122,  470, 344,  492,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 1114,  476};
uint16_t rawData23[200] = {3222, 3132,  448, 390,  442, 392,  468, 344,  492, 1124,  444, 392,  444,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 1116,  450};

uint16_t rawData21[200] = {3196, 3158,  474, 340,  470, 390,  460, 360,  486, 1120,  472, 338,  494,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 348,  464};

uint16_t rawData19[200] = {3238, 3112,  494, 350,  488, 346,  464, 392,  468, 1116,  454, 392,  466,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 354,  482};  

uint16_t rawData28[200] = {3192, 3154,  456, 390,  442, 408,  438, 390,  438, 1132,  478, 344,  452,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 1120,  468};

float temperature=30;

void setup() {
  irsend.begin();
  Serial.begin(115200);
  dht.begin();
  pinMode(BUZZER_PIN,OUTPUT);
  
 


}

void loop() {
  
  
  
  if(Serial.available()) {
    char person=Serial.read();
     temperature = dht.readTemperature();
    
    if(person=='0' ){
        irsend.sendRaw(rawData28, 200, 38);
        
        Serial.println("Temp SET:28");
         Serial.println("Temperature: ");
  Serial.print(temperature);
      
    }
    else if(person=='1' || person=='2' ){
        irsend.sendRaw(rawData25, 200, 38);
        
        Serial.println("Temp SET:25");
         Serial.println("Temperature: ");
  Serial.print(temperature);

    }
    else if((person=='3' || person=='4' ) && temperature>26){
        irsend.sendRaw(rawData23, 200, 38);
        
        Serial.println("Temp SET:23");
       Serial.println("Temperature: ");
  Serial.print(temperature);
    }
    else if((person=='5' || person=='6') && temperature>24){
        irsend.sendRaw(rawData21, 200, 38);
        
        Serial.println("Temp SET:21");
         Serial.println("Temperature: ");
  Serial.print(temperature);
    }
    else if((person=='7' || person=='8') && temperature>22){
        irsend.sendRaw(rawData19, 200, 38);
        
        Serial.println("Temp SET:19");
         Serial.println("Temperature: ");
  Serial.print(temperature);
    }
    else if(person=='9' || person=='10' || person=='11'){
            playSuperMarioTheme();

  

           delay(2000);
    }
    delay(1000);
    }
  
    
    
        
        
    
    
  
  
  
 
  
  
 
}
void playSuperMarioTheme() {
  int melody[] = {
    // Notes of the melody (frequency in Hz)
    659, 659, 0, 659, 0, 523, 659, 0, 784, 0, 392, 523, 0, 392, 523, 0,
    
  };

  int noteDuration = 200; // Duration of each note in milliseconds

  // Play each note of the melody
  for (int note = 0; note < sizeof(melody) / sizeof(melody[0]); note++) {
    if (melody[note] != 0) {
      tone(BUZZER_PIN, melody[note], noteDuration);
    }
    delay(noteDuration * 1.3); // Add a small delay between notes
    noTone(BUZZER_PIN); // Stop playing the note
  }
}